## boards/shields/corne/Kconfig.defconfig
```kconfig
# Corne behavior when building the LEFT half
if SHIELD_CORNE_LEFT

config ZMK_KEYBOARD_NAME
    default "Corne"

# Left half is the central/master device
config ZMK_SPLIT_ROLE_CENTRAL
    default y

endif


# Shared behavior for all Corne halves (left or right)
if SHIELD_CORNE_LEFT || SHIELD_CORNE_RIGHT || SHIELD_CORNE_LEFT_PERIPHERAL

# Enable split communication
config ZMK_SPLIT
    default y


# Display (OLED) support for boards that have screens
if ZMK_DISPLAY

config I2C
    default y

config SSD1306
    default y

endif # ZMK_DISPLAY


# LVGL block (only relevant if using nice!view or e-paper display)
if LVGL

config LV_Z_VDB_SIZE
    default 64

config LV_DPI_DEF
    default 148

config LV_Z_BITS_PER_PIXEL
    default 1

choice LV_COLOR_DEPTH
    default LV_COLOR_DEPTH_1
endchoice

endif # LVGL

endif
```
